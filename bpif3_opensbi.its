## bpif3_opensbi.its
```
/dts-v1/;

/ {
  description = "Minimal UART ELF runner for BPI-F3 (SpacemiT K1)";
  #address-cells = <2>;

  images {
    opensbi {
      description = "bpif3-uart-elf-runner";
      data = /incbin/("firmware.bin");
      type = "firmware";
      arch = "riscv";
      os = "opensbi";
      compression = "none";
      load = <0x00 0x04000000>;
      entry = <0x00 0x04000000>;
      hash-1 {
        algo = "crc32";
      };
    };
  };

  configurations {
    default = "config_1";
    config_1 {
      description = "Minimal UART runner config";
      firmware = "opensbi";
    };
  };
};
```

## vf2_act4.its
```
/dts-v1/;

/ {
  description = "Minimal UART ELF runner for JH7110 VisionFive2";
  #address-cells = <1>;

  images {
    firmware {
      description = "vf2-uart-elf-runner";
      data = /incbin/("firmware.bin");
      type = "firmware";
      arch = "riscv";
      os = "u-boot";
      compression = "none";
      load = <0x40000000>;
      entry = <0x40000000>;
    };
  };

  configurations {
    default = "config-1";
    config-1 {
      description = "Minimal UART runner config";
      firmware = "firmware";
    };
  };
};
```
